AUTOSAR XML (schema 4-2-2)
standard types defined: uint8, uint32, uint16, boolean, sint8, dtRef_VOID, dtRef_const_VOID, boolean_CompuMethod
package /DataTypes
  5 x impl type, all with category=TYPE_REFERENCE, implementation-data-type=uint8:
    Dem_DebouncingStateType
    Dem_DTCFormatType: compu {0=DEM_DTC_FORMAT_OBD, 1=DEM_DTC_FORMAT_UDS, 2=DEM_DTC_FORMAT_J1939}
    Dem_MaxDataValueType
    Dem_UdsStatusByteType
    NvM_RequestResultType: compu {0=NVM_REQ_OK, 1=NVM_REQ_NOT_OK, 2=NVM_REQ_PENDING, 3=NVM_REQ_INTEGRITY_FAILED, 4=NVM_REQ_BLOCK_SKIPPED, 5=NVM_REQ_NV_INVALIDATED, 6=NVM_REQ_CANCELED, 8=NVM_REQ_RESTORED_FROM_DEFAULTS}
package /DataTypes/SwAddrMethods
  sw addr method CODE: section-type=CODE
  sw addr method CONST: section-type=CONST
  sw addr method VAR: section-type=VAR
package /DataTypes/Units
  unit NoUnit: factor-si-to-unit=1, offset-si-to-unit=0
