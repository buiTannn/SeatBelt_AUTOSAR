AUTOSAR XML (schema 4-2-2)
package /Components/SwcImplementations
  swc implementation autosardemo2_Impl: programming-language=C, sw-version=1.12.1, used-code-generator=Embedded Coder 24.1 (R2024a) 19-Nov-2023, vendor-id=0, behavior=autosardemo2_IB
    code-descriptors:
      code Code
        artifact-descriptors:
          short-label=GetStatus_c, category=SWSRC
          short-label=MWDSP_EPH_F_B_c, category=SWSRC
          short-label=rt_roundd_c, category=SWSRC
          short-label=GetStatus_h, category=SWHDR
          short-label=GetStatus_private_h, category=SWHDR
          short-label=GetStatus_types_h, category=SWHDR
          short-label=MWDSP_EPH_F_B_h, category=SWHDR
          short-label=rt_roundd_h, category=SWHDR
    resource consumption RsrcCons_GetStatus
