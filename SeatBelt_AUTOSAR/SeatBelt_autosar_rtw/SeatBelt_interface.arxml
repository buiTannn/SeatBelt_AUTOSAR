AUTOSAR XML (schema 4-2-2)
package /Interfaces
  sender receiver interface SeatbeltIcon
    data SeatbeltIcon: category=VALUE, sw-calibration-access=READ-ONLY, type=boolean
  sender receiver interface SeatbeltFastenError
    data SeatbeltFastenError: category=VALUE, sw-calibration-access=READ-ONLY, type=boolean
  client server interface CheckStatus
  sender receiver interface VehicleSpeedInterface
    data Speed: category=VALUE, sw-calibration-access=READ-WRITE, type=uint16
  sender receiver interface SeatBeltInterface
    data SeatBeltFasten: category=VALUE, sw-calibration-access=READ-WRITE, type=boolean
  sender receiver interface IgnitionKeyInterface
    data Key: category=VALUE, sw-calibration-access=READ-WRITE, type=enState_IgnitionKey
