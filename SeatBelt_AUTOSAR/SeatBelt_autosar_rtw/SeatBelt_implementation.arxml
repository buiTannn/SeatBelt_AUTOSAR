AUTOSAR XML (schema 4-2-2)
package /Components/SwcImplementations
  swc implementation demo_Impl: programming-language=C, sw-version=1.41.1, used-code-generator=Embedded Coder 24.1 (R2024a) 19-Nov-2023, vendor-id=0, behavior=demo_IB
    code-descriptors:
      code Code
        artifact-descriptors:
          short-label=MWDSP_EPH_F_B_c, category=SWSRC
          short-label=SeatBelt_c, category=SWSRC
          short-label=rt_roundd_c, category=SWSRC
          short-label=MWDSP_EPH_F_B_h, category=SWHDR
          short-label=SeatBelt_h, category=SWHDR
          short-label=SeatBelt_private_h, category=SWHDR
          short-label=SeatBelt_types_h, category=SWHDR
          short-label=rt_roundd_h, category=SWHDR
    resource consumption RsrcCons_SetBelt
