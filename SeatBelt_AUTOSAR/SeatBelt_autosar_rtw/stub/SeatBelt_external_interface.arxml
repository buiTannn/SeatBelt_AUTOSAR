AUTOSAR XML (schema 4-2-2)
package /Interfaces
  client server interface NvMService: is-service=true
    12 x operation, all with possible-error=[NvMService/E_NOT_OK, NvMService/E_OK]:
      EraseNvBlock
      GetDataIndex
        arg DataIndexPtr: category=VALUE, type=uint8, direction=OUT
      GetErrorStatus
        arg RequestResultPtr: category=TYPE_REFERENCE, type=NvM_RequestResultType, direction=OUT
      InvalidateNvBlock
      ReadBlock
        arg NvM_DstPtr: category=DATA_REFERENCE, type=dtRef_VOID, direction=IN
      ReadPRAMBlock
      RestoreBlockDefaults
        arg NvM_DestPtr: category=DATA_REFERENCE, type=dtRef_VOID, direction=IN
      RestorePRAMBlockDefaults
      SetDataIndex
        arg DataIndex: category=VALUE, type=uint8, direction=IN
      SetRamBlockStatus
        arg BlockChanged: category=VALUE, type=boolean, direction=IN
      WriteBlock
        arg SrcPtr: category=DATA_REFERENCE, type=dtRef_const_VOID, direction=IN
      WritePRAMBlock
    error E_NOT_OK: error-code=1
    error E_OK: error-code=0
  client server interface DiagnosticMonitor: is-service=true
    6 x operation, all with possible-error=[DiagnosticMonitor/E_NOT_OK, DiagnosticMonitor/E_OK]:
      ClearPrestoredFreezeFrame
      PrestoreFreezeFrame
      ResetEventDebounceStatus
        arg DebounceResetStatus: category=TYPE_REFERENCE, type=Dem_DebounceResetStatusType, direction=IN
      ResetEventStatus
      SetEventDisabled
      SetEventStatus
        arg EventStatus: category=TYPE_REFERENCE, type=Dem_EventStatusType, direction=IN
    error E_NOT_OK: error-code=1
    error E_OK: error-code=0
