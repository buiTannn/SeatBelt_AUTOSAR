AUTOSAR XML (schema 4-2-2)
package /Interfaces
  sender receiver interface SpeedStuckHigh_GetFailedStatus
    data SpeedStuckHigh_GetFailedStatus: category=VALUE, sw-calibration-access=READ-ONLY, type=boolean
  sender receiver interface SpeedStuckLow_GetFailedStatus
    data SpeedStuckLow_GetFailedStatus: category=VALUE, sw-calibration-access=READ-ONLY, type=boolean
  sender receiver interface IgnitionKeySwitchCount_ReadBlock
    data IgnitionKeySwitchCount_ReadBlock: sw-calibration-access=READ-ONLY
