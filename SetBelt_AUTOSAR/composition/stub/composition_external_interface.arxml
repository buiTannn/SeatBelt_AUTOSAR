AUTOSAR XML (schema 4-2-2)
package /Interfaces
  client server interface DiagnosticInfo: is-service=true
    10 x operation:
      GetDebouncingOfEvent: possible-error=[DiagnosticInfo/E_NOT_OK, DiagnosticInfo/E_OK]
        arg DebouncingState: category=TYPE_REFERENCE, type=Dem_DebouncingStateType, direction=OUT
      GetDTCOfEvent: possible-error=[DEM_E_NO_DTC_AVAILABLE, DiagnosticInfo/E_NOT_OK, DiagnosticInfo/E_OK]
        arg DTCFormat: category=TYPE_REFERENCE, type=Dem_DTCFormatType, direction=IN
        arg DTCOfEvent: category=VALUE, type=uint32, direction=OUT
      GetEventExtendedDataRecord: possible-error=[DEM_E_NODATAAVAILABLE, DEM_E_WRONG_RECORDNUMBER, DiagnosticInfo/E_NOT_OK, DiagnosticInfo/E_OK]
        arg RecordNumber: category=VALUE, type=uint8, direction=IN
        arg DestBuffer: category=TYPE_REFERENCE, type=Dem_MaxDataValueType, direction=OUT
      GetEventExtendedDataRecordEx: possible-error=[DEM_E_NODATAAVAILABLE, DEM_E_WRONG_BUFFERSIZE, DEM_E_WRONG_RECORDNUMBER, DiagnosticInfo/E_NOT_OK, DiagnosticInfo/E_OK]
        arg RecordNumber: category=VALUE, type=uint8, direction=IN
        arg DestBuffer: category=TYPE_REFERENCE, type=Dem_MaxDataValueType, direction=OUT
        arg BufSize: category=VALUE, type=uint16, direction=INOUT
      GetEventFailed: possible-error=[DiagnosticInfo/E_NOT_OK, DiagnosticInfo/E_OK]
        arg EventFailed: category=VALUE, type=boolean, direction=OUT
      GetEventFreezeFrameData: possible-error=[DEM_E_NODATAAVAILABLE, DEM_E_WRONG_DIDNUMBER, DEM_E_WRONG_RECORDNUMBER, DiagnosticInfo/E_NOT_OK, DiagnosticInfo/E_OK]
        4 x arg:
          RecordNumber: category=VALUE, type=uint8, direction=IN
          ReportTotalRecord: category=VALUE, type=boolean, direction=IN
          DataId: category=VALUE, type=uint16, direction=IN
          DestBuffer: category=TYPE_REFERENCE, type=Dem_MaxDataValueType, direction=OUT
      GetEventFreezeFrameDataEx: possible-error=[DEM_E_NODATAAVAILABLE, DEM_E_WRONG_BUFFERSIZE, DEM_E_WRONG_DIDNUMBER, DEM_E_WRONG_RECORDNUMBER, DiagnosticInfo/E_NOT_OK, DiagnosticInfo/E_OK]
        4 x arg:
          RecordNumber: category=VALUE, type=uint8, direction=IN
          DataId: category=VALUE, type=uint16, direction=IN
          DestBuffer: category=TYPE_REFERENCE, type=Dem_MaxDataValueType, direction=OUT
          BufSize: category=VALUE, type=uint16, direction=INOUT
      GetEventStatus: possible-error=[DiagnosticInfo/E_NOT_OK, DiagnosticInfo/E_OK]
        arg EventStatusByte: category=TYPE_REFERENCE, type=Dem_UdsStatusByteType, direction=OUT
      GetEventTested: possible-error=[DiagnosticInfo/E_NOT_OK, DiagnosticInfo/E_OK]
        arg EventTested: category=VALUE, type=boolean, direction=OUT
      GetFaultDetectionCounter: possible-error=[DEM_E_NO_FDC_AVAILABLE, DiagnosticInfo/E_NOT_OK, DiagnosticInfo/E_OK]
        arg FaultDetectionCounter: category=VALUE, type=sint8, direction=OUT
    8 x error:
      DEM_E_NO_DTC_AVAILABLE: error-code=2
      DEM_E_NO_FDC_AVAILABLE: error-code=3
      DEM_E_NODATAAVAILABLE: error-code=48
      DEM_E_WRONG_BUFFERSIZE: error-code=21
      DEM_E_WRONG_DIDNUMBER: error-code=50
      DEM_E_WRONG_RECORDNUMBER: error-code=49
      E_NOT_OK: error-code=1
      E_OK: error-code=0
  client server interface NvMService: is-service=true
    12 x operation, all with possible-error=[NvMService/E_NOT_OK, NvMService/E_OK]:
      EraseNvBlock
      GetDataIndex
        arg DataIndexPtr: category=VALUE, type=uint8, direction=OUT
      GetErrorStatus
        arg RequestResultPtr: category=TYPE_REFERENCE, type=NvM_RequestResultType, direction=OUT
      InvalidateNvBlock
      ReadBlock
        arg NvM_DstPtr: category=DATA_REFERENCE, type=dtRef_VOID, direction=IN
      ReadPRAMBlock
      RestoreBlockDefaults
        arg NvM_DestPtr: category=DATA_REFERENCE, type=dtRef_VOID, direction=IN
      RestorePRAMBlockDefaults
      SetDataIndex
        arg DataIndex: category=VALUE, type=uint8, direction=IN
      SetRamBlockStatus
        arg BlockChanged: category=VALUE, type=boolean, direction=IN
      WriteBlock
        arg SrcPtr: category=DATA_REFERENCE, type=dtRef_const_VOID, direction=IN
      WritePRAMBlock
    error E_NOT_OK: error-code=1
    error E_OK: error-code=0
  client server interface DiagnosticMonitor: is-service=true
    6 x operation, all with possible-error=[DiagnosticMonitor/E_NOT_OK, DiagnosticMonitor/E_OK]:
      ClearPrestoredFreezeFrame
      PrestoreFreezeFrame
      ResetEventDebounceStatus
        arg DebounceResetStatus: category=TYPE_REFERENCE, type=Dem_DebounceResetStatusType, direction=IN
      ResetEventStatus
      SetEventDisabled
      SetEventStatus
        arg EventStatus: category=TYPE_REFERENCE, type=Dem_EventStatusType, direction=IN
    error E_NOT_OK: error-code=1
    error E_OK: error-code=0
